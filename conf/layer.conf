## conf/layer.conf
```bitbake
# We have a conf and classes directory, add to BBPATH
BBPATH .= ":${LAYERDIR}"

# We have recipes-* directories, add to BBFILES
BBFILES += "${LAYERDIR}/recipes-*/*/*.bb \
	${LAYERDIR}/recipes-*/*/*.bbappend"

BBFILE_COLLECTIONS += "meta-apple"
BBFILE_PATTERN_meta-apple = "^${LAYERDIR}/"
BBFILE_PRIORITY_meta-apple = "6"

LAYERSERIES_COMPAT_meta-apple = "sumo"

COPY_LIC_MANIFEST = "1"

PREFERRED_VERSION_libusbmuxd="1.1.0"
PREFERRED_VERSION_usbmuxd="1.1.0"
PREFERRED_VERSION_libimobiledevice="git"
PREFERRED_VERSION_ifuse="1.1.3"
PREFERRED_VERSION_libplist="1.12"
```
